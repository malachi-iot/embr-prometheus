## src/esp-idf/embr-prometheus/test_apps/unity/sdkconfig.defaults
```kconfig
# I still want a watchdog in case of catastrophic failure, but let it take a long time
# since this is a user interactive test
# DEBT: There's probably a way to set this JUST for the Unity input console
CONFIG_ESP_TASK_WDT_TIMEOUT_S=60
```
